/***************************************************************************************************************************************************
  Created by RoytechPrototype (Shawon Roy)
  Version: 1.2
  GitHub: https://github.com/superguine 
  
****************************************************************************************************************************************************/
#include <Adafruit_GFX.h>
#include <Adafruit_SSD1306.h>

const int tonePin = 25; // your speaker should be attached to this pin and ground 

// Notes used for boot sound
#define NOTE_D6  1175
#define NOTE_E6  1319
#define NOTE_G6  1568

// Display Configuration
#define SCREEN_WIDTH 128
#define SCREEN_HEIGHT 64
#define OLED_RESET -1
Adafruit_SSD1306 display(SCREEN_WIDTH, SCREEN_HEIGHT, &Wire, OLED_RESET);

int w=0,t;
bool ta=false,tb=false; 
void setup() {
  Serial.begin(115200);
  if (!display.begin(SSD1306_SWITCHCAPVCC, 0x3C)) {
    Serial.println(F("SSD1306 allocation failed"));
    for (;;);
  }
  BootImg();
  display.clearDisplay();
  pinMode(LED_BUILTIN,OUTPUT);
}

void loop() {
  display.clearDisplay();
  display.setCursor(0, 0);
  Serial.print(touchRead(12));
  Serial.print(" ");
  Serial.println(touchRead(13));
  
  // case 1   Right to Left 
  if ( touchRead(12) <95){
    t=0;
    ta = true ;
    digitalWrite(LED_BUILTIN,1);
  }
  while(ta && t<200){
  if ( touchRead(13) <88){
    ta=false;
    int i = 0;
    while (i<20 && w>=0 ){
      display.clearDisplay();
      display.setCursor(0, 0);
      display.print("Swipe gesture on \n\nMicroNova32");
      display.drawRect( 0, 32, 128 , 10, SSD1306_WHITE);
      display.fillRect( 0, 32, w -=1 , 10, SSD1306_WHITE);
      display.setCursor(25, 50);
      display.print("Right to Left"); 
      display.display();
      i++;
    }
    break;
  }
  delay(1);
  t +=1;
  }
  
  
  
  // case 2   Left to Right 
  
  if ( touchRead(13) <88){
    t=0;
    tb = true ;
    digitalWrite(LED_BUILTIN,1);
  }
  
  while(tb && t<200){
  if ( touchRead(12) <95 && tb){
    tb=false;
    int j = 0;
    while (j<20 && w<=128 ){
      display.clearDisplay();
      display.setCursor(0, 0);
      display.print("Swipe gesture on \n\nMicroNova32");
      display.drawRect( 0, 32, 128 , 10, SSD1306_WHITE);
      display.fillRect( 0, 32, w +=1 , 10, SSD1306_WHITE); 
      display.setCursor(25, 50);
      display.print("Left to Right");
      display.display();
      j++;
    }
    break;
  }
  delay(1);
  t +=1;
  }

  
  digitalWrite(LED_BUILTIN,0);
  display.setCursor(0, 0);
  display.print("Swipe gesture on \n\nMicroNova32");
  display.drawRect( 0, 32, 128 , 10, SSD1306_WHITE);
  display.fillRect( 0, 32, w , 10, SSD1306_WHITE);
  display.display();
  
}

//---------------------------------------------below part contains boot image and boot sound ------------------------------------
const uint8_t rp_logo2[] PROGMEM = {
    // Bitmap data goes here (truncated for brevity)
      	0x00, 0x00, 0x00, 0x00, 0x00, 0x00, 0x00, 0x00, 0x00, 0x00, 0x00, 0x00, 0x00, 0x00, 0x00, 0x00, 
	0x00, 0x00, 0x00, 0x00, 0x00, 0x00, 0x00, 0x1f, 0xf8, 0x00, 0x00, 0x00, 0x00, 0x00, 0x00, 0x00, 
	0x00, 0x00, 0x00, 0x00, 0x00, 0x00, 0x00, 0xff, 0xff, 0x00, 0x00, 0x00, 0x00, 0x00, 0x00, 0x00, 
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	0x00, 0x00, 0x00, 0x00, 0x00, 0x00, 0x00, 0x00, 0x00, 0x00, 0x00, 0x00, 0x00, 0x00, 0x00, 0x00
};

void BootImg(){  
  display.clearDisplay();
  BootSound();
  display.drawBitmap(0, 0, rp_logo2, SCREEN_WIDTH, SCREEN_HEIGHT, SSD1306_WHITE);
  display.setTextSize(1);           // Normal 1:1 pixel scale
  display.setTextColor(SSD1306_WHITE); // Draw white text
  display.setCursor(43, 42);         // Position for text
  display.println(F("Roytech"));
  display.setCursor(35, 55);         // Another position for more text
  display.println(F("Prototypes"));
  display.display();
  delay(1500);  // display time 
  display.clearDisplay();
  display.display();
  delay(500); // blank time 
}

void BootSound() {
  int melody[] = {  NOTE_D6, NOTE_E6,NOTE_D6, NOTE_E6,NOTE_G6};
  int noteDurations[] = {16, 16, 16, 16,4};
  for (int i = 0; i < sizeof(melody) / sizeof(melody[0]); i++) {
    int note = melody[i];
    int duration = 1000 / noteDurations[i]; 
    if (note > 0) {
      tone(tonePin, note, duration);
    }
  }
}