/******************************************************************************************************************************************
  Created by Roytech Prototypes (Shawon Roy).
  date: 24/10/24
  Version: v1.1
  GitHub: https://github.com/superguine 
  -----------------------------------------------------------------------------------
  Download "pitches.h" header file from here: https://gist.github.com/mikeputnam/2820675 
  NOTE : I don't own " pitches.h ".

*//*****************************************************************************************************************************************/


// bouncing ball animation 
#include <Adafruit_GFX.h>
#include <Adafruit_SSD1306.h>
#include <Wire.h>
#include "pitches.h"

#define SCREEN_WIDTH 128
#define SCREEN_HEIGHT 64  // Available OLED height
#define OLED_RESET -1
Adafruit_SSD1306 display(SCREEN_WIDTH, SCREEN_HEIGHT, &Wire, OLED_RESET);

#define BALL_RADIUS 2  // Ball radius

// Speaker config
const int tonePin = 25; // Pin connected to the speaker

int ballX = SCREEN_WIDTH / 2;  // Ball's initial X position (centered)
int ballY = SCREEN_HEIGHT / 2; // Ball's initial Y position (centered)
int ballSpeedX = 2;   // Speed of ball in the X direction
int ballSpeedY = 2;   // Speed of ball in the Y direction

const int speedButtonPin = 18;  // Pin for speed control button (middle button)
const int ledPin = LED_BUILTIN; // Built-in LED pin

int delayTimes[] = {1,5, 10, 20, 40};  // Array of delay times for different speeds
int currentDelayIndex = 0;  // To track the current speed delay

bool speedChanged = false; // Flag to check if speed button was pressed

void setup() {
  Serial.begin(115200);

  // Initialize OLED
  if (!display.begin(SSD1306_SWITCHCAPVCC, 0x3C)) {
    Serial.println(F("SSD1306 allocation failed"));
    for (;;);
  }

  display.clearDisplay();

  // Initialize button pin and LED pin
  pinMode(speedButtonPin, INPUT_PULLUP); // Speed button pin with pull-up resistor
  pinMode(ledPin, OUTPUT); // Built-in LED pin
  BootImg();
}

void loop() {
  // Check if the speed button is pressed
  if (digitalRead(speedButtonPin) == LOW) {
    // Change the delay time (speed) randomly through predefined values
    currentDelayIndex = (currentDelayIndex + 1) % 5;  // Cycle through 5 different delay times

    // Turn on the LED briefly to indicate speed change
    digitalWrite(ledPin, HIGH);
    delay(100);
    digitalWrite(ledPin, LOW);
    delay(100);

    speedChanged = true;
  }

  // Clear the display for the next frame
  display.clearDisplay();

  // Draw the ball at its current position
  display.fillCircle(ballX, ballY, BALL_RADIUS, WHITE); // Draw the ball

  // Move the ball
  ballX += ballSpeedX;
  ballY += ballSpeedY;

  // Check for collisions with the left and right edges of the screen
  if (ballX - BALL_RADIUS <= 0 || ballX + BALL_RADIUS >= SCREEN_WIDTH) {
    ballSpeedX = random(1, 5);  // Random horizontal speed after bounce
    if (ballX - BALL_RADIUS <= 0) {
      ballSpeedX = abs(ballSpeedX);  // Ensure it moves right if it hit the left edge
    }
    if (ballX + BALL_RADIUS >= SCREEN_WIDTH) {
      ballSpeedX = -abs(ballSpeedX);  // Ensure it moves left if it hit the right edge
    }
  }

  // Check for collisions with the top and bottom edges of the screen
  if (ballY - BALL_RADIUS <= 0 || ballY + BALL_RADIUS >= SCREEN_HEIGHT) {
    ballSpeedY = random(1, 5);  // Random vertical speed after bounce
    if (ballY - BALL_RADIUS <= 0) {
      ballSpeedY = abs(ballSpeedY);  // Ensure it moves down if it hit the top edge
    }
    if (ballY + BALL_RADIUS >= SCREEN_HEIGHT) {
      ballSpeedY = -abs(ballSpeedY);  // Ensure it moves up if it hit the bottom edge
    }
  }

  // Update the display with the new frame
  display.display();

  // Delay to control the speed of the animation based on current speed setting
  delay(delayTimes[currentDelayIndex]);  // Adjusted delay based on button press
  speedChanged = false;  // Reset the speed change flag
}



//---------------  Below section contains only Boot sound and Boot image --------------------------- 

//booot sound 
void BootSound() {
  int melody[] = {  NOTE_D6, NOTE_E6,NOTE_D6, NOTE_E6,NOTE_G6};
  int noteDurations[] = {4, 16, 16, 16,4};
  for (int i = 0; i < sizeof(melody) / sizeof(melody[0]); i++) {
    int note = melody[i];
    int duration = 1000 / noteDurations[i]; 
    if (note > 0) {
      tone(tonePin, note, duration);
    }
  }
}

// Boot Image data
const uint8_t rp_logo2[] PROGMEM = {
  // Bitmap data goes here (truncated for brevity)
  0x00, 0x00, 0x00, 0x00, 0x00, 0x00, 0x00, 0x00, 0x00, 0x00, 0x00, 0x00, 0x00, 0x00, 0x00, 0x00, 
	0x00, 0x00, 0x00, 0x00, 0x00, 0x00, 0x00, 0x1f, 0xf8, 0x00, 0x00, 0x00, 0x00, 0x00, 0x00, 0x00, 
	0x00, 0x00, 0x00, 0x00, 0x00, 0x00, 0x00, 0xff, 0xff, 0x00, 0x00, 0x00, 0x00, 0x00, 0x00, 0x00, 
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	0x00, 0x00, 0x00, 0x00, 0x00, 0x00, 0x00, 0x00, 0x00, 0x00, 0x00, 0x00, 0x00, 0x00, 0x00, 0x00
};

void BootImg(){  
  display.clearDisplay();
  display.drawBitmap(0, 0, rp_logo2, SCREEN_WIDTH, SCREEN_HEIGHT, SSD1306_WHITE);
  display.setTextSize(1);           
  display.setTextColor(SSD1306_WHITE); // Draw white text
  display.setCursor(43, 42);         // Position for text
  display.println(F("Roytech"));
  display.setCursor(35, 55);         // Another position for more text
  display.println(F("Prototypes"));
  display.display();
  BootSound(); // boot sound
  delay(1500);  // display time 
  display.clearDisplay();
  display.display();
  delay(500); // blank time 
}